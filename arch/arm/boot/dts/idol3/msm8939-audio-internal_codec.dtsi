/* Copyright (c) 2014, The Linux Foundation. All rights reserved.
 *
 * This program is free software; you can redistribute it and/or modify
 * it under the terms of the GNU General Public License version 2 and
 * only version 2 as published by the Free Software Foundation.
 *
 * This program is distributed in the hope that it will be useful,
 * but WITHOUT ANY WARRANTY; without even the implied warranty of
 * MERCHANTABILITY or FITNESS FOR A PARTICULAR PURPOSE.  See the
 * GNU General Public License for more details.
 */

&soc {
	sound {
		compatible = "qcom,msm8x16-audio-codec";
		qcom,model = "msm8939-snd-card-mtp";
		qcom,msm-snd-card-id = <0>;
		qcom,msm-codec-type = "internal";
		qcom,msm-ext-pa = "secondary", "quaternary";/*NB.THW 2014/11/17 add for FR.789207*/
		qcom,msm-mbhc-hphl-swh = <1>;/*NB.HJ 2014/11/19 NO type*/
		qcom,msm-mbhc-gnd-swh = <0>;
		qcom,msm-micbias1-ext-cap;
		qcom,msm-mclk-freq = <12288000>;/*NB.THW 2014/11/17 add for FR.789207*/
		qcom,msm-hs-micbias-type = "internal";
		qcom,audio-routing =
			"RX_BIAS", "MCLK",
			"SPK_RX_BIAS", "MCLK",
			"INT_LDO_H", "MCLK",
/* [PLATFORM]-Add-BEGIN by TCTNB.HJ, 2014/11/20*/
			"MIC BIAS Internal1", "Handset Mic",
			"MIC BIAS Internal2", "Headset Mic",
			"MIC BIAS External", "Secondary Mic",
			"AMIC1", "MIC BIAS Internal1",
			"AMIC2", "MIC BIAS Internal2",
			"AMIC3", "MIC BIAS External";
/* [PLATFORM]-Add-END by TCTNB.HJ, 2014/11/20*/
		pinctrl-names = "cdc_lines_act",
				"cdc_lines_sus",
				/*NB.THW 2014/11/17 add for FR.789207*/
				"cdc_lines_sec_ext_act",
				"cdc_lines_sec_ext_sus",
				"cdc_lines_quat_ext_act",
				"cdc_lines_quat_ext_sus",
				/*NB.THW 2014/11/17 end*/
				"cross_conn_det_act",
				"cross_conn_det_sus";

		pinctrl-0 = <&cdc_pdm_lines_act>;
		pinctrl-1 = <&cdc_pdm_lines_sus>;
		/*NB.THW 2014/11/17 add for FR.789207*/
		pinctrl-2 = <&cdc_pdm_lines_act &cdc_ext_pa_act
						&cdc_ext_pa_ws_act>;
		pinctrl-3 = <&cdc_pdm_lines_sus &cdc_ext_pa_sus
						&cdc_ext_pa_ws_sus>;
		pinctrl-4 = <&cdc_pdm_lines_act &ext_cdc_tlmm_lines_act >;
		pinctrl-5 = <&cdc_pdm_lines_sus &ext_cdc_tlmm_lines_sus >;
		pinctrl-6 = <&cross_conn_det_act>;
		pinctrl-7 = <&cross_conn_det_sus>;
		/*NB.THW 2014/11/17 end*/

//		qcom,cdc-us-euro-gpios = <&msm_gpio 120 0>;/*NB.THW 2014/11/17 remove for FR.789207*/
	};
};

/* [PLATFORM]-Add-BEGIN by TCTNB.HJ, 2014/11/18, HIFI*/
&i2c_4 {
	ak4375_device: ak4375@10 {
		compatible = "akm,ak4375";
		reg = <0x10>;
        pinctrl-names = "akm_pwdn_active",
                        "akm_pwdn_suspend";
        pinctrl-0 = <&akm_pwdn_active>;
        pinctrl-1 = <&akm_pwdn_suspend>;
        akm,cdc-pwdn-gpios = <&msm_gpio 101 0>;
	};
};
/* [PLATFORM]-Add-END by TCTNB.HJ*/

