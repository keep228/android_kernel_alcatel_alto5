/* Copyright (c) 2014, The Linux Foundation. All rights reserved.
 *
 * This program is free software; you can redistribute it and/or modify
 * it under the terms of the GNU General Public License version 2 and
 * only version 2 as published by the Free Software Foundation.
 *
 * This program is distributed in the hope that it will be useful,
 * but WITHOUT ANY WARRANTY; without even the implied warranty of
 * MERCHANTABILITY or FITNESS FOR A PARTICULAR PURPOSE.  See the
 * GNU General Public License for more details.
 */

/*---------------------------------------------------------------------------
 * This file is autogenerated file using gcdb parser. Please do not edit it.
 * Update input XML file to add a new entry or update variable in this file
 * VERSION = "1.0"
 *---------------------------------------------------------------------------*/
&mdss_mdp {
	dsi_hx8379c_fwvga_vid: qcom,mdss_dsi_hx8379c_fwvga_video {
		qcom,mdss-dsi-panel-name = "hx8379c video mode dsi panel";
		qcom,mdss-dsi-panel-controller = <&mdss_dsi0>;
		qcom,mdss-dsi-panel-type = "dsi_video_mode";
		qcom,mdss-dsi-panel-destination = "display_1";
        qcom,mdss-dsi-panel-framerate = <60>;
		qcom,mdss-dsi-virtual-channel-id = <0>;
		qcom,mdss-dsi-stream = <0>;
		qcom,mdss-dsi-panel-width = <480>;
		qcom,mdss-dsi-panel-height = <800>;
		qcom,mdss-dsi-h-front-porch = <100>;
		qcom,mdss-dsi-h-back-porch = <80>;
		qcom,mdss-dsi-h-pulse-width = <4>;
		qcom,mdss-dsi-h-sync-skew = <0>;
		qcom,mdss-dsi-v-back-porch = <9>;
		qcom,mdss-dsi-v-front-porch = <20>;
		qcom,mdss-dsi-v-pulse-width = <2>;
		qcom,mdss-dsi-h-left-border = <0>;
		qcom,mdss-dsi-h-right-border = <0>;
		qcom,mdss-dsi-v-top-border = <0>;
		qcom,mdss-dsi-v-bottom-border = <0>;
		qcom,mdss-dsi-bpp = <24>;
		qcom,mdss-dsi-color-order = "rgb_swap_rgb";
		qcom,mdss-dsi-underflow-color = <0xff>;
		qcom,mdss-dsi-border-color = <0>;
		qcom,mdss-dsi-on-command = [
		
        39 01 00 00 00 00 04 B9  FF  83  79  
		   
		39 01 00 00 00 00 15 B1  C4  1A  1A  31  31  50  D0  EA  62  80
						 38  38  F8  32  32  22  00  80  30  00  

		39 01 00 00 00 00 0A B2  80  3C  0B  05  00  50  11  42  1D    
		39 01 00 00 00 00 0B B4  0A  6A  0A  6A  0A  6A  22  80  22  80
		39 01 00 00 00 00 02 CC  02  
		39 01 00 00 00 00 02 D2  11  
		39 01 00 00 00 00 1E D3  00  07  00  00  00  07  00  32  10  03
						 00  03  03  2A  03  2A  00  08  00  08   
						 45  44  08  08  37  08  08  37  09       
		39 01 00 00 00 00 21 D5  18  18  19  19  18  18  20  21  24  25 
		     			 18  18  18  18  00  01  02  03  04  05 
		     			 06  07  18  18  18  18  18  18  18  18  
		     			 18  18  
		39 01 00 00 00 00 21 D6  18  18  18  18  19  19  25  24  21  20 
						 18  18  18  18  07  06  05  04  03  02 
						 01  00  18  18  18  18  18  18  18  18 
						 18  18  
		39 01 00 00 00 00 2B E0  00  02  04  07  08  3E  17  2C  04  08
						 0B  16  12  16  18  16  16  08  12  13  18
						 00  02  04  07  08  3E  17  2C  04  08
						 0B  16  12  16  18  16  16  08  12  13
						 18  
		39 01 00 00 00 00 03 B6 4F 4F
		15 01 00 00 00 00 02 35 00  
		05 01 00 00 96 00 02 11 00
		05 01 00 00 32 00 02 29 00];
		qcom,mdss-dsi-off-command = [05 01 00 00 02 00 02 28 00
					05 01 00 00 79 00 02 10 00];
		qcom,mdss-dsi-on-command-state = "dsi_lp_mode";
		qcom,mdss-dsi-off-command-state = "dsi_hs_mode";
		qcom,mdss-dsi-h-sync-pulse = <1>;
		qcom,mdss-dsi-traffic-mode = <2>;//"burst_mode";
		qcom,mdss-dsi-lane-map =<0>; //"lane_map_0123";//modify by yusen.ke.sz@tcl.com at 20140714 for lcd driver
		qcom,mdss-dsi-bllp-eof-power-mode;
		qcom,mdss-dsi-bllp-power-mode;
		qcom,mdss-dsi-lane-0-state;
		qcom,mdss-dsi-lane-1-state;
//		qcom,mdss-dsi-lane-2-state;
//		qcom,mdss-dsi-lane-3-state;
		qcom,mdss-dsi-panel-timings = [D5 18 10 00 38 3E 12 20 13 03 04 00];
		qcom,mdss-dsi-t-clk-post = <0x05>;
		qcom,mdss-dsi-t-clk-pre = <0x36>;
		qcom,mdss-dsi-panel-clockrate = <368500000>;
		qcom,mdss-dsi-bl-min-level = <1>;
		qcom,mdss-dsi-bl-max-level = <255>;
		qcom,mdss-dsi-dma-trigger = <4>;//"trigger_sw";
		qcom,mdss-dsi-mdp-trigger = <0>;//"none";
		qcom,mdss-dsi-bl-pmic-control-type = "bl_ctrl_wled";
		qcom,mdss-dsi-reset-sequence = <1 20>, <0 2>, <1 115>;
		qcom,mdss-pan-physical-width-dimension = <0>;
		qcom,mdss-pan-physical-height-dimension = <0>;
/*[PLATFORM]-Add-BEGIN by TCTNB.CY, PR-882696, 2015/1/13, add LCD ESD check*/
		qcom,esd-check-enabled;
		qcom,mdss-dsi-panel-status-command = [
			14 01 00 01 05 00 01 0a
		];
		qcom,mdss-dsi-panel-status-command-state = "dsi_lp_mode";
		qcom,mdss-dsi-panel-status-check-mode = "reg_read";
		qcom,mdss-dsi-panel-status-value = <0x1c>;
/*[PLATFORM]-Add-END by TCTNB.CY, 2015/1/13*/
	};
};
