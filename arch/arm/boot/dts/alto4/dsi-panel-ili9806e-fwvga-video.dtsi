/* Copyright (c) 2014, The Linux Foundation. All rights reserved.
 *
 * This program is free software; you can redistribute it and/or modify
 * it under the terms of the GNU General Public License version 2 and
 * only version 2 as published by the Free Software Foundation.
 *
 * This program is distributed in the hope that it will be useful,
 * but WITHOUT ANY WARRANTY; without even the implied warranty of
 * MERCHANTABILITY or FITNESS FOR A PARTICULAR PURPOSE.  See the
 * GNU General Public License for more details.
 */

/*---------------------------------------------------------------------------
 * This file is autogenerated file using gcdb parser. Please do not edit it.
 * Update input XML file to add a new entry or update variable in this file
 * VERSION = "1.0"
 *---------------------------------------------------------------------------*/
&mdss_mdp {
	dsi_ili9806e_fwvga_vid: qcom,mdss_dsi_ili9806e_fwvga_video {
		qcom,mdss-dsi-panel-name = "ili9806e video mode dsi panel modify";
		qcom,mdss-dsi-panel-controller = <&mdss_dsi0>;
		qcom,mdss-dsi-panel-type = "dsi_video_mode";
		qcom,mdss-dsi-panel-destination = "display_1";
        	qcom,mdss-dsi-panel-framerate = <60>;
		qcom,mdss-dsi-virtual-channel-id = <0>;
		qcom,mdss-dsi-stream = <0>;
		qcom,mdss-dsi-panel-width = <480>;
		qcom,mdss-dsi-panel-height = <800>;
		qcom,mdss-dsi-h-front-porch = <100>;
		qcom,mdss-dsi-h-back-porch = <100>;
		qcom,mdss-dsi-h-pulse-width = <4>;
		qcom,mdss-dsi-h-sync-skew = <0>;
		qcom,mdss-dsi-v-back-porch = <16>;
		qcom,mdss-dsi-v-front-porch = <20>;
		qcom,mdss-dsi-v-pulse-width = <4>;
		qcom,mdss-dsi-h-left-border = <0>;
		qcom,mdss-dsi-h-right-border = <0>;
		qcom,mdss-dsi-v-top-border = <0>;
		qcom,mdss-dsi-v-bottom-border = <0>;
		qcom,mdss-dsi-bpp = <24>;
		qcom,mdss-dsi-color-order = "rgb_swap_rgb";
		qcom,mdss-dsi-underflow-color = <0xff>;
		qcom,mdss-dsi-border-color = <0>;
		qcom,mdss-dsi-on-command = [
                        39 01 00 00 00 00 06 FF FF 98 06 04 01
			   15 01 00 00 00 00 02 08 10
			   15 01 00 00 00 00 02 21 01
			   15 01 00 00 00 00 02 30 02
                        15 01 00 00 00 00 02 31 00
                        15 01 00 00 00 00 02 60 07
                        15 01 00 00 00 00 02 61 06
                        15 01 00 00 00 00 02 62 06
                        15 01 00 00 00 00 02 63 04
                        15 01 00 00 00 00 02 40 14
                        15 01 00 00 00 00 02 41 33
                        15 01 00 00 00 00 02 42 02
                        15 01 00 00 00 00 02 43 09
                        15 01 00 00 00 00 02 44 0c
                        15 01 00 00 00 00 02 45 1B
                        15 01 00 00 00 00 02 46 44
                        15 01 00 00 00 00 02 47 44
                      
                        15 01 00 00 00 00 02 50 78
                        15 01 00 00 00 00 02 51 78
                        15 01 00 00 00 00 02 52 00
                        15 01 00 00 00 00 02 53 63
                        15 01 00 00 00 00 02 57 50
                        15 01 00 00 00 00 02 A0 00
                        15 01 00 00 00 00 02 A1 07
                        15 01 00 00 00 00 02 A2 12
                        15 01 00 00 00 00 02 A3 13
                        15 01 00 00 00 00 02 A4 0b
                        15 01 00 00 00 00 02 A5 1f
                        15 01 00 00 00 00 02 A6 0b
                        15 01 00 00 00 00 02 A7 0a
                        15 01 00 00 00 00 02 A8 03
                        15 01 00 00 00 00 02 A9 09
                        15 01 00 00 00 00 02 AA 02
                        15 01 00 00 00 00 02 AB 05
                        15 01 00 00 00 00 02 AC 0a
                        15 01 00 00 00 00 02 AD 2e
                        15 01 00 00 00 00 02 AE 29
                        15 01 00 00 00 00 02 AF 00
                        15 01 00 00 00 00 02 C0 00
                        15 01 00 00 00 00 02 C1 00
                        15 01 00 00 00 00 02 C2 0a
                        15 01 00 00 00 00 02 C3 0f
                        15 01 00 00 00 00 02 C4 0a
                        15 01 00 00 00 00 02 C5 1c
                        15 01 00 00 00 00 02 C6 0a
                        15 01 00 00 00 00 02 C7 07
                        15 01 00 00 00 00 02 C8 04
                        15 01 00 00 00 00 02 C9 09
                        15 01 00 00 00 00 02 CA 05
                        15 01 00 00 00 00 02 CB 06
                        15 01 00 00 00 00 02 CC 0d
                        15 01 00 00 00 00 02 CD 1f
                        15 01 00 00 00 00 02 CE 18
                        15 01 00 00 00 00 02 CF 00
                        39 01 00 00 00 00 06 FF FF 98 06 04 06
                        15 01 00 00 00 00 02 00 A0
                        15 01 00 00 00 00 02 01 05
                        15 01 00 00 00 00 02 02 00
                        15 01 00 00 00 00 02 03 00
                        15 01 00 00 00 00 02 04 01
                        15 01 00 00 00 00 02 05 01
                        15 01 00 00 00 00 02 06 88
                        15 01 00 00 00 00 02 07 04
                        15 01 00 00 00 00 02 08 01
                        15 01 00 00 00 00 02 09 90
                        15 01 00 00 00 00 02 0A 04
                        15 01 00 00 00 00 02 0B 01
                        15 01 00 00 00 00 02 0C 01
                        15 01 00 00 00 00 02 0D 01
                        15 01 00 00 00 00 02 0E 00
                        15 01 00 00 00 00 02 0F 00
                        15 01 00 00 00 00 02 10 55
                        15 01 00 00 00 00 02 11 50
                        15 01 00 00 00 00 02 12 01
                        15 01 00 00 00 00 02 13 85
                        15 01 00 00 00 00 02 14 85
                        15 01 00 00 00 00 02 15 c0
                        15 01 00 00 00 00 02 16 0B
                        15 01 00 00 00 00 02 17 00
                        15 01 00 00 00 00 02 18 00
                        15 01 00 00 00 00 02 19 00
                        15 01 00 00 00 00 02 1A 00
                        15 01 00 00 00 00 02 1B 00
                        15 01 00 00 00 00 02 1C 00
                        15 01 00 00 00 00 02 1D 00
                        15 01 00 00 00 00 02 20 01
                        15 01 00 00 00 00 02 21 23
                        15 01 00 00 00 00 02 22 45
                        15 01 00 00 00 00 02 23 67
                        15 01 00 00 00 00 02 24 01
                        15 01 00 00 00 00 02 25 23
                        15 01 00 00 00 00 02 26 45
                        15 01 00 00 00 00 02 27 67
                        15 01 00 00 00 00 02 30 02
                        15 01 00 00 00 00 02 31 22
                        15 01 00 00 00 00 02 32 11
                        15 01 00 00 00 00 02 33 AA
                        15 01 00 00 00 00 02 34 BB
                        15 01 00 00 00 00 02 35 66
                        15 01 00 00 00 00 02 36 00
                        15 01 00 00 00 00 02 37 22
                        15 01 00 00 00 00 02 38 22
                        15 01 00 00 00 00 02 39 22
                        15 01 00 00 00 00 02 3A 22
                        15 01 00 00 00 00 02 3B 22
                        15 01 00 00 00 00 02 3C 22
                        15 01 00 00 00 00 02 3D 22
                        15 01 00 00 00 00 02 3E 22
                        15 01 00 00 00 00 02 3F 22
                        15 01 00 00 00 00 02 40 22
                        15 01 00 00 00 00 02 52 10
                        15 01 00 00 00 00 02 53 10
			15 01 00 00 00 00 02 58 97

                        39 01 00 00 00 00 06 FF FF 98 06 04 07
                        15 01 00 00 00 00 02 17 22
                        15 01 00 00 00 00 02 02 77
                        15 01 00 00 00 00 02 E1 79
                        15 01 00 00 00 00 02 06 13

                        39 01 00 00 00 00 06 FF FF 98 06 04 00
                        05 01 00 00 78 00 02 11 00
                        05 01 00 00 0A 00 02 29 00
                       ];
		qcom,mdss-dsi-off-command = [05 01 00 00 02 00 02 28 00
					05 01 00 00 79 00 02 10 00];
		qcom,mdss-dsi-on-command-state = "dsi_lp_mode";
		qcom,mdss-dsi-off-command-state = "dsi_hs_mode";
		qcom,mdss-dsi-h-sync-pulse = <1>;
		qcom,mdss-dsi-traffic-mode = "burst_mode";
		qcom,mdss-dsi-lane-map = "lane_map_0123";
		qcom,mdss-dsi-bllp-eof-power-mode;
		qcom,mdss-dsi-bllp-power-mode;
		qcom,mdss-dsi-lane-0-state;
		qcom,mdss-dsi-lane-1-state;
		qcom,mdss-dsi-panel-timings = [E3 1A 10 00 3E 42 14 1C 15 03 04 00];
		qcom,mdss-dsi-t-clk-post = <0x04>;
		qcom,mdss-dsi-t-clk-pre = <0x25>;
		qcom,mdss-dsi-panel-clockrate = <417000000>;
		qcom,mdss-dsi-bl-min-level = <1>;
		qcom,mdss-dsi-bl-max-level = <255>;
		qcom,mdss-dsi-dma-trigger = "trigger_sw";
		qcom,mdss-dsi-mdp-trigger = "none";
		qcom,mdss-dsi-bl-pmic-control-type = "bl_ctrl_wled";
		qcom,mdss-dsi-reset-sequence = <1 5>, <0 5>, <1 115>;
		qcom,mdss-pan-physical-width-dimension = <0>;
		qcom,mdss-pan-physical-height-dimension = <0>;
	};
};
